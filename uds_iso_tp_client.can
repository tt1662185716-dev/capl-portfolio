/*-----------------------------------------------------------------------------
 *  uds_iso_tp_client.can
 *
 *  A raw ISO-TP / UDS client written directly against the CAN bus.
 *
 *  Why not the CANoe diagnostic API?
 *  The diagnostic API (diagRequest / diagSendRequest) requires an ODX/CDD
 *  description file, which makes the code non-runnable for anyone who does not
 *  have the project database. Implementing ISO-TP explicitly keeps this file
 *  self-contained and shows what is actually on the bus.
 *
 *  Supported
 *    TX : single frame (payload <= 7 bytes)
 *    RX : single frame and multi-frame (first frame + consecutive frames),
 *         flow control is sent back to the peer, sequence numbers validated
 *    P2 : 50 ms, P2* : 5000 ms, negative response 0x78 restarts P2*
 *
 *  Not implemented (documented extension points)
 *    - multi-frame transmission (payload > 7 bytes)
 *    - CAN FD / ISO-TP over CAN FD
 *    - functional addressing (29-bit, 0x18DB33F1)
 *
 *  Prerequisites : none - only classic CAN identifiers 0x7E0 / 0x7E8
 *  Keys          : 'u' tester present, 'v' read DID 0xF190,
 *                  'w' extended session, 'i' inject malformed length
 *----------------------------------------------------------------------------*/

variables
{
  /* -------- identifiers -------- */
  dword ID_REQ  = 0x7E0;
  dword ID_RESP = 0x7E8;

  /* -------- timing -------- */
  long P2_MS       = 50;
  long P2_STAR_MS  = 5000;
  long TESTER_PRESENT_MS = 2000;

  /* -------- timers -------- */
  msTimer tP2;
  msTimer tTesterPresent;

  /* -------- message objects -------- */
  message 0x7E0 msgReq;

  /* -------- transmit buffer -------- */
  byte gTxPayload[64];
  long gTxLength = 0;

  /* -------- receive state machine -------- */
  byte  gRxBuffer[512];
  long  gRxLength   = 0;    /* bytes stored so far              */
  long  gRxExpected = 0;    /* total length declared in FF      */
  long  gRxActive   = 0;    /* 1 while a multi-frame is running */
  byte  gRxNextSeq  = 1;    /* expected consecutive frame SN    */

  /* -------- statistics -------- */
  long gRequests  = 0;
  long gPositive  = 0;
  long gNegative  = 0;
  long gTimeouts  = 0;
  long gPending   = 0;
  long gLastNrc   = 0;
  long gBusy      = 0;
}

/*-----------------------------------------------------------------------------
 *  Helpers
 *----------------------------------------------------------------------------*/

void udsSendFlowControl()
{
  msgReq.dlc     = 8;
  msgReq.byte(0) = 0x30;   /* flow status = continue to send             */
  msgReq.byte(1) = 0x00;   /* block size 0 = send all remaining frames   */
  msgReq.byte(2) = 0x00;   /* separation time min = 0                    */
  msgReq.byte(3) = 0xCC;
  msgReq.byte(4) = 0xCC;
  msgReq.byte(5) = 0xCC;
  msgReq.byte(6) = 0xCC;
  msgReq.byte(7) = 0xCC;

  output(msgReq);
}

/* Transmit a UDS request. payload may be empty when payloadLength == 0. */
void udsSend(byte service, byte payload[], long payloadLength)
{
  long i;
  long total;

  total = payloadLength + 1;

  if (total > 7)
  {
    write("[UDS] ERROR: payload of %d bytes needs multi-frame TX (not implemented)",
          total);
    return;
  }

  gTxPayload[0] = service;
  for (i = 0; i < payloadLength; i++)
  {
    gTxPayload[1 + i] = payload[i];
  }

  msgReq.dlc     = 8;
  msgReq.byte(0) = (byte)total;            /* PCI: single frame, length    */

  for (i = 0; i < total; i++)
  {
    msgReq.byte(1 + i) = gTxPayload[i];
  }
  for (i = 1 + total; i < 8; i++)
  {
    msgReq.byte(i) = 0xCC;                 /* padding                      */
  }

  gRxLength   = 0;
  gRxExpected = 0;
  gRxActive   = 0;
  gBusy       = 1;
  gRequests   = gRequests + 1;

  output(msgReq);
  setTimer(tP2, P2_MS);

  write("[UDS] TX -> service 0x%02X, %d byte(s)", service, total);
}

void udsPrintResponse()
{
  long i;

  write("[UDS] RX <- %d byte(s):", gRxLength);
  for (i = 0; i < gRxLength; i++)
  {
    write("        [%02d] 0x%02X", i, gRxBuffer[i]);
  }
}

void udsProcessResponse()
{
  long nrc;
  byte expectedPositive;

  gBusy = 0;
  cancelTimer(tP2);

  if (gRxLength < 1)
  {
    write("[UDS] ERROR: empty response");
    return;
  }

  /* -------- negative response -------- */
  if (gRxBuffer[0] == 0x7F)
  {
    if (gRxLength < 3)
    {
      write("[UDS] ERROR: truncated negative response");
      return;
    }

    nrc = (long)gRxBuffer[2];

    /* response pending - the server needs more time, restart P2* */
    if (nrc == 0x78)
    {
      gPending = gPending + 1;
      write("[UDS] NRC 0x78 responsePending - waiting for the final answer");
      setTimer(tP2, P2_STAR_MS);
      gBusy = 1;
      return;
    }

    gNegative = gNegative + 1;
    gLastNrc  = nrc;
    write("[UDS] NEGATIVE response, service 0x%02X, NRC 0x%02X",
          gRxBuffer[1], nrc);
    return;
  }

  /* -------- positive response -------- */
  expectedPositive = (byte)(gRxBuffer[0] - 0x40);
  gPositive = gPositive + 1;

  write("[UDS] POSITIVE response, service 0x%02X (+0x40)", expectedPositive);
  udsPrintResponse();
}

/*-----------------------------------------------------------------------------
 *  Receive path: ISO-TP reassembly
 *----------------------------------------------------------------------------*/

on message 0x7E8
{
  long pciType;
  long length;
  long i;

  if (this.dlc < 8)
  {
    write("[UDS] WARN: response frame with dlc=%d", this.dlc);
  }

  pciType = ((long)this.byte(0) >> 4) & 0x0F;

  /* -------- single frame -------- */
  if (pciType == 0)
  {
    length = (long)this.byte(0) & 0x0F;
    if (length > 7)
    {
      write("[UDS] ERROR: single frame length %d > 7", length);
      return;
    }

    gRxLength = 0;
    for (i = 0; i < length; i++)
    {
      gRxBuffer[i] = this.byte(1 + i);
      gRxLength = gRxLength + 1;
    }

    gRxActive = 0;
    udsProcessResponse();
    return;
  }

  /* -------- first frame -------- */
  if (pciType == 1)
  {
    gRxExpected = ((long)this.byte(0) & 0x0F) * 256 + (long)this.byte(1);

    if (gRxExpected < 8 || gRxExpected > 512)
    {
      write("[UDS] ERROR: implausible first frame length %d", gRxExpected);
      return;
    }

    gRxLength  = 0;
    gRxActive  = 1;
    gRxNextSeq = 1;

    for (i = 0; i < 6; i++)
    {
      if (gRxLength < gRxExpected)
      {
        gRxBuffer[gRxLength] = this.byte(2 + i);
        gRxLength = gRxLength + 1;
      }
    }

    /* ask the peer to continue */
    udsSendFlowControl();
    setTimer(tP2, P2_STAR_MS);
    return;
  }

  /* -------- consecutive frame -------- */
  if (pciType == 2)
  {
    if (gRxActive == 0)
    {
      write("[UDS] WARN: consecutive frame without first frame, ignored");
      return;
    }

    if (((long)this.byte(0) & 0x0F) != (long)gRxNextSeq)
    {
      write("[UDS] ERROR: sequence mismatch, expected %d got %d - abort",
            gRxNextSeq, ((long)this.byte(0) & 0x0F));
      gRxActive = 0;
      return;
    }

    gRxNextSeq = (byte)((gRxNextSeq + 1) & 0x0F);

    for (i = 0; i < 7; i++)
    {
      if (gRxLength < gRxExpected)
      {
        gRxBuffer[gRxLength] = this.byte(1 + i);
        gRxLength = gRxLength + 1;
      }
    }

    if (gRxLength >= gRxExpected)
    {
      gRxActive = 0;
      udsProcessResponse();
    }
    return;
  }

  /* -------- flow control from peer (only relevant for multi-frame TX) -------- */
  if (pciType == 3)
  {
    write("[UDS] INFO: flow control received (multi-frame TX not implemented)");
    return;
  }
}

/*-----------------------------------------------------------------------------
 *  Public service wrappers
 *----------------------------------------------------------------------------*/

void udsTesterPresent()
{
  gTxPayload[0] = 0x00;
  udsSend(0x3E, gTxPayload, 0);
}

void udsStartExtendedSession()
{
  gTxPayload[0] = 0x03;                 /* extended diagnostic session */
  udsSend(0x10, gTxPayload, 1);
}

void udsReadDid(word did)
{
  byte payload[2];

  payload[0] = (byte)((did >> 8) & 0xFF);
  payload[1] = (byte)(did & 0xFF);

  udsSend(0x22, payload, 2);
}

void udsEcuReset()
{
  gTxPayload[0] = 0x01;                 /* hard reset */
  udsSend(0x11, gTxPayload, 1);
}

/*-----------------------------------------------------------------------------
 *  Timers
 *----------------------------------------------------------------------------*/

on timer tP2
{
  if (gBusy == 0)
  {
    return;
  }

  gBusy = 0;
  gTimeouts = gTimeouts + 1;
  write("[UDS] TIMEOUT - no response within the P2/P2* window");
}

on timer tTesterPresent
{
  udsTesterPresent();
  setTimer(tTesterPresent, TESTER_PRESENT_MS);
}

/*-----------------------------------------------------------------------------
 *  Lifecycle and keyboard control
 *----------------------------------------------------------------------------*/

on start
{
  write("[UDS] client ready - request 0x7E0 / response 0x7E8");
}

on stopMeasurement
{
  write("[UDS] summary: requests %d | positive %d | negative %d | timeouts %d",
        gRequests, gPositive, gNegative, gTimeouts);

  if (gNegative > 0)
  {
    write("[UDS] last NRC: 0x%02X", gLastNrc);
  }
}

on key 'u'
{
  udsTesterPresent();
}

on key 'v'
{
  udsReadDid(0xF190);          /* VIN, multi-frame response expected */
}

on key 'w'
{
  udsStartExtendedSession();
}

on key 'i'
{
  /* deliberately malformed request: claims 12 bytes in a single frame */
  msgReq.dlc     = 8;
  msgReq.byte(0) = 0x0C;
  msgReq.byte(1) = 0x22;
  msgReq.byte(2) = 0xF1;
  msgReq.byte(3) = 0x90;
  msgReq.byte(4) = 0xCC;
  msgReq.byte(5) = 0xCC;
  msgReq.byte(6) = 0xCC;
  msgReq.byte(7) = 0xCC;
  output(msgReq);
  write("[UDS] injected malformed single frame (length 12) for error-path testing");
}
